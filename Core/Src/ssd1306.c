#include "ssd1306.h"
#include <string.h>

// 5x7 font for ASCII characters 32-127
static const uint8_t font5x7[][5] = {
    {0x00,0x00,0x00,0x00,0x00}, // space
    {0x00,0x00,0x5F,0x00,0x00}, // !
    {0x00,0x07,0x00,0x07,0x00}, // "
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    {0x08,0x08,0x2A,0x1C,0x08}, // ~
};

static uint8_t buffer[SSD1306_WIDTH * SSD1306_HEIGHT / 8];
static uint8_t cursor_x = 0;
static uint8_t cursor_y = 0;
static I2C_HandleTypeDef *ssd1306_i2c;

static void SSD1306_WriteCommand(uint8_t cmd)
{
    uint8_t data[2] = {0x00, cmd};
    HAL_I2C_Master_Transmit(ssd1306_i2c, SSD1306_ADDR, data, 2, HAL_MAX_DELAY);
}

void SSD1306_Init(I2C_HandleTypeDef *hi2c)
{
    ssd1306_i2c = hi2c;

    HAL_Delay(100); // Wait for OLED to power up

    SSD1306_WriteCommand(0xAE); // Display off
    SSD1306_WriteCommand(0x20); // Set memory addressing mode
    SSD1306_WriteCommand(0x00); // Horizontal addressing mode
    SSD1306_WriteCommand(0xB0); // Set page start address
    SSD1306_WriteCommand(0xC8); // COM output scan direction remapped
    SSD1306_WriteCommand(0x00); // Set low column address
    SSD1306_WriteCommand(0x10); // Set high column address
    SSD1306_WriteCommand(0x40); // Set start line address
    SSD1306_WriteCommand(0x81); // Set contrast
    SSD1306_WriteCommand(0xFF); // Max contrast
    SSD1306_WriteCommand(0xA1); // Segment remap
    SSD1306_WriteCommand(0xA6); // Normal display (not inverted)
    SSD1306_WriteCommand(0xA8); // Set multiplex ratio
    SSD1306_WriteCommand(0x3F); // 1/64 duty
    SSD1306_WriteCommand(0xA4); // Output follows RAM
    SSD1306_WriteCommand(0xD3); // Set display offset
    SSD1306_WriteCommand(0x00); // No offset
    SSD1306_WriteCommand(0xD5); // Set display clock divide
    SSD1306_WriteCommand(0xF0); // Set divide ratio
    SSD1306_WriteCommand(0xD9); // Set pre-charge period
    SSD1306_WriteCommand(0x22);
    SSD1306_WriteCommand(0xDA); // Set COM pins hardware config
    SSD1306_WriteCommand(0x12);
    SSD1306_WriteCommand(0xDB); // Set VCOMH deselect level
    SSD1306_WriteCommand(0x20);
    SSD1306_WriteCommand(0x8D); // Charge pump setting
    SSD1306_WriteCommand(0x14); // Enable charge pump
    SSD1306_WriteCommand(0xAF); // Display on

    SSD1306_Clear();
    SSD1306_UpdateScreen(hi2c);
}

void SSD1306_Clear(void)
{
    memset(buffer, 0, sizeof(buffer));
    cursor_x = 0;
    cursor_y = 0;
}

void SSD1306_UpdateScreen(I2C_HandleTypeDef *hi2c)
{
    for (uint8_t page = 0; page < 8; page++) {
        SSD1306_WriteCommand(0xB0 + page);
        SSD1306_WriteCommand(0x00);
        SSD1306_WriteCommand(0x10);

        uint8_t data[SSD1306_WIDTH + 1];
        data[0] = 0x40; // Data mode
        memcpy(&data[1], &buffer[SSD1306_WIDTH * page], SSD1306_WIDTH);
        HAL_I2C_Master_Transmit(hi2c, SSD1306_ADDR, data, SSD1306_WIDTH + 1, HAL_MAX_DELAY);
    }
}

void SSD1306_SetCursor(uint8_t x, uint8_t y)
{
    cursor_x = x;
    cursor_y = y;
}

void SSD1306_WriteChar(char ch)
{
    if (ch < 32 || ch > 126) return;
    if (cursor_x + 6 > SSD1306_WIDTH) {
        cursor_x = 0;
        cursor_y += 1;
    }
    if (cursor_y >= 8) return;

    for (uint8_t i = 0; i < 5; i++) {
        buffer[cursor_x + (cursor_y * SSD1306_WIDTH) + i] = font5x7[ch - 32][i];
    }
    buffer[cursor_x + (cursor_y * SSD1306_WIDTH) + 5] = 0x00; // Space between chars
    cursor_x += 6;
}

void SSD1306_WriteString(const char *str)
{
    while (*str) {
        SSD1306_WriteChar(*str++);
    }
}
